## testbed/final_runtime/vehicle/mqtt/c0/main/Kconfig.projbuild
```kconfig
menu "OCC MQTT Runtime C0"

config OCC_WIFI_SSID
    string "Wi-Fi SSID"
    default ""

config OCC_WIFI_PASSWORD
    string "Wi-Fi password"
    default ""

config OCC_MQTT_BROKER_URI
    string "OCC MQTT broker URI"
    default "mqtt://occ-pi.local:1883"
    help
        Vehicle-facing MQTT broker address.
        This is configuration, not hardcoded application logic.

config OCC_VEHICLE_ID
    string "Vehicle identity"
    default "VM-001"

config OCC_RUNTIME_PERIOD_MS
    int "Operational telemetry period in milliseconds"
    range 50 60000
    default 100
    help
        100 ms = 10 Hz.
        This is operational telemetry, not the formal FAIR scheduler.

endmenu
```

## testbed/final_runtime/vehicle/mqtt/c2/main/Kconfig.projbuild
```kconfig
menu "OCC MQTT Runtime C1"

config OCC_SNTP_SERVER
    string "SNTP server for TLS certificate validation"
    default "occ-pi.local"
    help
        Time source required before MQTT C2 TLS validation.
        Override for networks using a local NTP server.

config OCC_MQTT_BROKER_URI
    string "OCC MQTT broker URI"
    default "mqtts://occ-pi.local:8883"
    help
        Vehicle-facing MQTT broker address.
        This is configuration, not hardcoded application logic.

config OCC_VEHICLE_ID
    string "Vehicle identity"
    default "VM-001"

config OCC_RUNTIME_PERIOD_MS
    int "Operational telemetry period in milliseconds"
    range 50 60000
    default 100
    help
        100 ms = 10 Hz.
        This is operational telemetry, not the formal FAIR scheduler.

endmenu
```

## testbed/final_runtime/vehicle/mqtt/selectable/main/Kconfig.projbuild
```kconfig
menu "OCC MQTT Selectable Runtime"

config OCC_MQTT_DEFAULT_PROFILE
    string "Default MQTT security profile"
    default "C2"
    help
        Initial profile used when no runtime profile exists in NVS.
        Valid values: C0, C1, C2.

config OCC_TLS_SERVER_NAME
    string "C2 TLS server identity"
    default "occ-pi.local"
    help
        Certificate identity used for C2 verification.
        Routing destination and TLS identity are intentionally
        separate.

config OCC_SNTP_PRIMARY_SERVER
    string "Primary SNTP server for C2 TLS certificate validation"
    default "pool.ntp.org"
    help
        Network-independent time source used first when Internet
        connectivity is available. The runtime OCC endpoint is
        retained only as a fallback time source.

config OCC_VEHICLE_ID
    string "Vehicle identity"
    default "VM-001"

config OCC_RUNTIME_PERIOD_MS
    int "Operational telemetry period in milliseconds"
    range 50 60000
    default 100
    help
        100 ms = 10 Hz.
        Operational runtime only; does not change the frozen FAIR benchmark.

endmenu
```

## testbed/hardware/esp32/dds/formal/c0/vehicle1/main/Kconfig.projbuild
```kconfig
menu "FAIR-V1 Formal DDS Vehicle 1"
config FAIR_WIFI_SSID
    string "Wi-Fi SSID"
    default ""
config FAIR_WIFI_PASSWORD
    string "Wi-Fi password"
    default ""
config FAIR_DDS_AGENT_IP
    string "Micro XRCE-DDS Agent IPv4 address"
    default ""
config FAIR_DDS_AGENT_PORT
    string "Micro XRCE-DDS Agent UDP port"
    default "8888"
config FAIR_RUN_ID
    string "FAIR run ID"
    default ""
config FAIR_REPEAT_INDEX
    int "FAIR repeat index"
    range 1 5
    default 1
config FAIR_WORKLOAD_SPEED
    string "FAIR workload speed"
    default ""
config FAIR_WORKLOAD_POS_X
    string "FAIR workload pos_x"
    default ""
config FAIR_WORKLOAD_POS_Y
    string "FAIR workload pos_y"
    default ""
config FAIR_WORKLOAD_HEADING
    string "FAIR workload heading"
    default ""
config FAIR_WORKLOAD_BATTERY_PCT
    string "FAIR workload battery_pct"
    default ""
config FAIR_WORKLOAD_STATE
    string "FAIR workload state"
    default ""
endmenu
```

## testbed/hardware/esp32/dds/formal/c2/vehicle1/main/Kconfig.projbuild
```kconfig
menu "FAIR-V1 Formal DDS Vehicle 1"
config FAIR_WIFI_SSID
    string "Wi-Fi SSID"
    default ""
config FAIR_WIFI_PASSWORD
    string "Wi-Fi password"
    default ""
config FAIR_DDS_AGENT_IP
    string "Micro XRCE-DDS Agent IPv4 address"
    default ""
config FAIR_DDS_AGENT_PORT
    string "Micro XRCE-DDS Agent UDP port"
    default "8888"
config FAIR_RUN_ID
    string "FAIR run ID"
    default ""
config FAIR_REPEAT_INDEX
    int "FAIR repeat index"
    range 1 5
    default 1
config FAIR_WORKLOAD_SPEED
    string "FAIR workload speed"
    default ""
config FAIR_WORKLOAD_POS_X
    string "FAIR workload pos_x"
    default ""
config FAIR_WORKLOAD_POS_Y
    string "FAIR workload pos_y"
    default ""
config FAIR_WORKLOAD_HEADING
    string "FAIR workload heading"
    default ""
config FAIR_WORKLOAD_BATTERY_PCT
    string "FAIR workload battery_pct"
    default ""
config FAIR_WORKLOAD_STATE
    string "FAIR workload state"
    default ""
endmenu


config FAIR_DDS_DOMAIN_ID
    int "Native DDS Domain ID"
    range 0 232
    default 2
    help
        DDS domain used by the C2 XRCE participant.
        Use domain 2 to isolate C2 from C0/C1 domain 0.
```

## testbed/hardware/esp32/mqtt/formal/c0/vehicle1/main/Kconfig.projbuild
```kconfig
menu "FAIR-V1 MQTT Vehicle 1"

config FAIR_WIFI_SSID
    string "Wi-Fi SSID"
    default ""

config FAIR_WIFI_PASSWORD
    string "Wi-Fi password"
    default ""

config FAIR_SNTP_SERVER
    string "SNTP server for TLS profile"
    default ""
    help
        Required at runtime for C2.
        Leave empty for compile-only builds.

config FAIR_MQTT_BROKER_URI
    string "MQTT broker URI"
    default ""
    help
        C0/C1 use mqtt://
        C2 uses mqtts://

config FAIR_MQTT_USERNAME
    string "MQTT username"
    default ""
    help
        Required for C1 and C2.
        Keep generated sdkconfig local.

config FAIR_MQTT_PASSWORD
    string "MQTT password"
    default ""
    help
        Required for C1 and C2.
        Keep generated sdkconfig local.

config FAIR_MQTT_CA_CERT_PEM
    string "MQTT CA certificate PEM"
    default ""
    help
        Required for C2 runtime.
        Keep deployment material out of committed sdkconfig.

config FAIR_RUN_ID
    string "FAIR run ID"
    default ""

config FAIR_REPEAT_INDEX
    int "FAIR repeat index"
    range 1 5
    default 1

config FAIR_WORKLOAD_SPEED
    string "FAIR workload speed"
    default ""

config FAIR_WORKLOAD_POS_X
    string "FAIR workload pos_x"
    default ""

config FAIR_WORKLOAD_POS_Y
    string "FAIR workload pos_y"
    default ""

config FAIR_WORKLOAD_HEADING
    string "FAIR workload heading"
    default ""

config FAIR_WORKLOAD_BATTERY_PCT
    string "FAIR workload battery_pct"
    default ""

config FAIR_WORKLOAD_STATE
    string "FAIR workload state"
    default ""

endmenu
```

## testbed/hardware/esp32/opcua/formal/c1/vehicle1/main/Kconfig.projbuild
```kconfig
menu "FAIR-V1 Formal OPC UA Vehicle 1"

config FAIR_WIFI_SSID
    string "Wi-Fi SSID"
    default ""

config FAIR_WIFI_PASSWORD
    string "Wi-Fi password"
    default ""

config FAIR_SNTP_SERVER
    string "SNTP server for secure profiles"
    default ""

config FAIR_OPCUA_ENDPOINT
    string "Formal OPC UA endpoint URL"
    default ""

config FAIR_OPCUA_USERNAME
    string "OPC UA username"
    default ""

config FAIR_OPCUA_PASSWORD
    string "OPC UA password"
    default ""

config FAIR_RUN_ID
    string "FAIR run ID"
    default ""

config FAIR_REPEAT_INDEX
    int "FAIR repeat index"
    range 1 5
    default 1

config FAIR_WORKLOAD_SPEED
    string "FAIR workload speed"
    default ""

config FAIR_WORKLOAD_POS_X
    string "FAIR workload pos_x"
    default ""

config FAIR_WORKLOAD_POS_Y
    string "FAIR workload pos_y"
    default ""

config FAIR_WORKLOAD_HEADING
    string "FAIR workload heading"
    default ""

config FAIR_WORKLOAD_BATTERY_PCT
    string "FAIR workload battery_pct"
    default ""

config FAIR_WORKLOAD_STATE
    string "FAIR workload state"
    default ""

endmenu
```

## testbed/hardware/vehicle/mqtt/c1/main/Kconfig.projbuild
```kconfig
menu "OCC MQTT Runtime C1"

config OCC_MQTT_BROKER_URI
    string "OCC MQTT broker URI"
    default "mqtt://occ-pi.local:1884"
    help
        Vehicle-facing MQTT broker address.
        This is configuration, not hardcoded application logic.

config OCC_VEHICLE_ID
    string "Vehicle identity"
    default "VM-001"

config OCC_RUNTIME_PERIOD_MS
    int "Operational telemetry period in milliseconds"
    range 50 60000
    default 100
    help
        100 ms = 10 Hz.
        This is operational telemetry, not the formal FAIR scheduler.

endmenu
```

## testbed/hardware/vehicle/mqtt/selectable/main/Kconfig.projbuild
```kconfig
menu "OCC MQTT Selectable Runtime"

config OCC_MQTT_DEFAULT_PROFILE
    string "Default MQTT security profile"
    default "C2"
    help
        Initial profile used when no runtime profile exists in NVS.
        Valid values: C0, C1, C2.

config OCC_TLS_SERVER_NAME
    string "C2 TLS server identity"
    default "occ-pi.local"
    help
        Certificate identity used for C2 verification.
        Routing destination and TLS identity are intentionally
        separate.

config OCC_OPCUA_LOCAL_NTP_SERVER
    string "OPC UA local NTP host (empty uses provisioned OCC host)"
    default ""
    help
        First time source for OPC UA only. Must be a host/IP, not a URL.
        Empty follows the existing provisioned OCC host across networks.
        Public SNTP sources remain fallbacks. Does not change MQTT or DDS.

config OCC_SNTP_PRIMARY_SERVER
    string "Primary SNTP server for C2 TLS certificate validation"
    default "pool.ntp.org"
    help
        Network-independent time source used first when Internet
        connectivity is available. The runtime OCC endpoint is
        retained only as a fallback time source.

config OCC_VEHICLE_ID
    string "Vehicle identity"
    default "VM-001"

config OCC_RUNTIME_PERIOD_MS
    int "Operational telemetry period in milliseconds"
    range 50 60000
    default 100
    help
        100 ms = 10 Hz.
        Operational runtime only; does not change the frozen FAIR benchmark.

endmenu
```
